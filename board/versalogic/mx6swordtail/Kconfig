## board/versalogic/mx6swordtail/Kconfig
```kconfig
if TARGET_MX6SWORDTAIL || TARGET_MX6SWORDTAIL_COMMON

config SYS_BOARD
	default "mx6swordtail"

config SYS_VENDOR
	default "versalogic"

config SYS_CONFIG_NAME
	default "mx6swordtail"

config SYS_TEXT_BASE
    default 0x17800000

endif
```

## board/versalogic/mx6tetra/Kconfig
```kconfig
if TARGET_MX6TETRA || TARGET_MX6TETRA_COMMON

config SYS_BOARD
	default "mx6tetra"

config SYS_VENDOR
	default "versalogic"

config SYS_CONFIG_NAME
	default "mx6tetra"

config SYS_TEXT_BASE
    default 0x17800000

endif
```

## configs/mx6solozebra_defconfig
```kconfig
CONFIG_ARM=y
CONFIG_ARCH_MX6=y
CONFIG_TARGET_MX6ZEBRA=y
CONFIG_VIDEO=y
CONFIG_SYS_EXTRA_OPTIONS="IMX_CONFIG=board/versalogic/mx6zebra/mx6solo_2x_mt41j128_zebra.cfg,MX6DL,SYS_NOSMP=\"nosmp\",SYS_BOOT_SPINOR"
CONFIG_BOOTDELAY=3
# CONFIG_CONSOLE_MUX is not set
CONFIG_SYS_CONSOLE_IS_IN_ENV=y
CONFIG_SYS_CONSOLE_OVERWRITE_ROUTINE=y
CONFIG_HUSH_PARSER=y
CONFIG_CMD_BOOTZ=y
# CONFIG_CMD_IMLS is not set
# CONFIG_CMD_FLASH is not set
CONFIG_CMD_MEMTEST=y
CONFIG_CMD_MMC=y
CONFIG_CMD_SF=y
CONFIG_CMD_I2C=y
CONFIG_CMD_USB=y
CONFIG_CMD_GPIO=y
CONFIG_CMD_DHCP=y
CONFIG_CMD_MII=y
CONFIG_CMD_PING=y
CONFIG_CMD_CACHE=y
CONFIG_CMD_EXT2=y
CONFIG_CMD_EXT4=y
CONFIG_CMD_EXT4_WRITE=y
CONFIG_CMD_FAT=y
CONFIG_CMD_FS_GENERIC=y
CONFIG_USB=y
CONFIG_USB_STORAGE=y
# CONFIG_VIDEO_SW_CURSOR is not set
# CONFIG_OF_LIBFDT=y

CONFIG_DEFAULT_DEVICE_TREE="imx6dl-zebra"
CONFIG_OF_CONTROL=y
# CONFIG_BLK is not set
CONFIG_DM_GPIO=y
CONFIG_DM_I2C=y
CONFIG_DM_MMC=y
# CONFIG_DM_MMC_OPS is not set
CONFIG_PINCTRL=y
CONFIG_PINCTRL_IMX6=y
CONFIG_DM_PMIC=y
CONFIG_DM_PMIC_PFUZE100=y
CONFIG_DM_REGULATOR=y
CONFIG_DM_REGULATOR_PFUZE100=y
CONFIG_DM_REGULATOR_FIXED=y
CONFIG_DM_REGULATOR_GPIO=y
CONFIG_DM_ETH=y
CONFIG_DM_USB=y
CONFIG_DM=y
CONFIG_DM_THERMAL=y
CONFIG_SPI_FLASH_USE_4K_SECTORS=y
CONFIG_SPI_FLASH_MTD=y
CONFIG_SPI_BOOT=y
```
